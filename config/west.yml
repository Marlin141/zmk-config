## config/west.yml
```yaml
manifest:
  defaults:
    revision: v0.3 # This defines the global revision


  remotes:
    - name: zmkfirmware
      url-base: https://github.com/zmkfirmware            
    - name: bildermankawasaki
      url-base: https://github.com/bildermankawasaki
    - name: urob
      url-base: https://github.com/urob

  projects:
    - name: zmk
      remote: zmkfirmware
      import: app/west.yml
      revision: v0.3 

    - name: zmk-keyboard-totem
      remote: bildermankawasaki
      revision: main
    - name: zmk-helpers
      remote: urob
      revision: 0b9e9d1dd9e86f70b4c8c2b0fab55c4f90c9d2e3 # main (4/19/2026)
    - name: zmk-unicode
      remote: urob
      revision: 1a6dbc797a46c4a61c3c71a7a9d013a5d5aee49e # main (4/19/2026) 
    - name: zmk-leader-key
      remote: urob
      revision: 749f7faf65cc4105c82fbe64cfaa7e09a8a63605 # main (4/19/2026)
    - name: zmk-tri-state
      remote: urob
      revision: 2007896c6d5bfb519e8babccf8633841c5647d8b # main (4/19/2026)
  self:
    path: config
```
