#include <behaviors.dtsi>
#include <behaviors/unicode.dtsi> // Requires zmk-unicode module.
#include <zmk-helpers/helper.h> // Requires zmk-helpers module.
#include <dt-bindings/zmk/keys.h>

// BT 
#include <dt-bindings/zmk/bt.h>
#include <dt-bindings/zmk/outputs.h>

// #include <dt-bindings/zmk/pointing.h> // Included in mouse.dtsi
#include "zmk-helpers/key-labels/totem.h" // HRM + combos
#include "zmk-helpers/unicode-chars/greek.dtsi" // Add Greek chars.
#include "zmk-helpers/unicode-chars/french.dtsi" // Add French chars
//#include "zmk-helpers/unicode-chars/latin_1_supplement.dtsi"

//#include <zmk-unicode/keys-extra.h>  // All glyphs except CJK
#include <zmk-unicode/keys-full.h>   // All glyphs including CJK



// #include <behaviors/num_word.dtsi>

#define DEF    0 // Base layer (normal keyboard)
#define NUM    1 // Number keys + Navigation
#define NAV    2 // Just navigation
#define FN     3 // System keys (bt, brightness, ect)
#define MOUSE  4 // Mouse movement + Scrolling
#define GAME   5 // Never really used 


/*                     KEY POSITIONS
      ╭─────────────────────╮ ╭─────────────────────╮
  ╭───╯ LT4 LT3 LT2 LT1 LT0 │ │ RT0 RT1 RT2 RT3 RT4 ╰───╮
  │ LM5 LM4 LM3 LM2 LM1 LM0 │ │ RM0 RM1 RM2 RM3 RM4 RM5 │
  ╰───╮ LB4 LB3 LB2 LB1 LB0 │ │ RB0 RB1 RB2 RB3 RB4 ╭───╯
      ╰───────╮ LH2 LH1 LH0 │ │ RH0 RH1 RH2 ╭───────╯
              ╰─────────────╯ ╰─────────────╯ */
             
&sk {
  release-after-ms = <900>;
  quick-release;
};

&sl { // Allow sticky mods to chord across sticky layers.
  ignore-modifiers;
};

&lt {
  flavor = "balanced";
  tapping-term-ms = <200>;
  quick-tap-ms = <175>;
};


/* Homerow mods */
#define MAKE_HRM(NAME, HOLD, TAP, TAPPING_TERM, TRIGGER_POS)    \
  ZMK_HOLD_TAP(NAME,                                            \
    bindings = <HOLD>, <TAP>;                                   \
    flavor = "balanced";                                        \
    tapping-term-ms = <TAPPING_TERM>;                           \
    quick-tap-ms = <175>;                                       \
    require-prior-idle-ms = <150>;                              \
    hold-trigger-on-release;                                    \
    hold-trigger-key-positions = <TRIGGER_POS>;)

MAKE_HRM(hml, &kp, &kp, 280, KEYS_R THUMBS) // Left-hand
MAKE_HRM(hmr, &kp, &kp, 280, KEYS_L THUMBS) // Right-hand

MAKE_HRM(hmls, &kp, &kp, 200, KEYS_R THUMBS) // Left-hand shift
MAKE_HRM(hmrs, &kp, &kp, 200, KEYS_L THUMBS) // Right-hand shift


// Make HRM combos tap-only (makes combos better)
#define ZMK_COMBO_8(NAME, TAP, POS, LAYERS, COMBO_MS, IDLE_MS, HOLD, SIDE)     \
  MAKE_HRM(hm_combo_##NAME, &kp, TAP, 150, SIDE THUMBS)                        \
  ZMK_COMBO_6(NAME, &hm_combo_##NAME HOLD 0, POS, LAYERS, COMBO_MS, IDLE_MS)


#include "combos.dtsi" // Must be referanced after hrm hack above
#include "leader.dtsi"
#include "mouse.dtsi"


/* Caps Word Settings */
&caps_word {
    // Allow caps word to continue even when minus or underscore
    // are pressed.
    // Also prevent mod presses from cancelling caps word.
    continue-list = <
      UNDERSCORE MINUS
      LCTRL LALT LGUI LSHFT
      RCTRL RALT RGUI RSHFT
      BACKSPACE
    >;
};

/* Custom Caps Lock Word using urob-style ZMK_BEHAVIOR helper 
ZMK_BEHAVIOR(caps_lock_word, caps_word,
    /* Replaces virtual Shift with physical OS Caps Lock toggles /
    mods = <MOD_CLCK>;      
    
    /* urob's default alphanumeric continuation preferences /
    continue-list = <
       UNDERSCORE MINUS BACKSPACE
    >;
)
*/


/*
 * Custom Caps Lock Word implementation using urob's helper macros.
 * Taps OS Caps Lock on, tracks alphas/continuations, and taps Caps Lock off on break.
ZMK_TRI_STATE(caps_lock_word,
    bindings = <&kp CAPSLOCK>, <&none>, <&kp CAPSLOCK>;
    ignored-codes = <UNDERSCORE MINUS BACKSPACE>;
    continue-if-alpha;
)
 */



/*
// Tap: num-word | double-tap: sticky num-layer | Hold: num-layer.
#define SMART_NUM &smart_num NUM 0
ZMK_HOLD_TAP(smart_num, bindings = <&mo>, <&num_dance>; flavor = "balanced";
             tapping-term-ms = <200>; quick-tap-ms = <QUICK_TAP_MS>;)
ZMK_TAP_DANCE(num_dance, bindings = <&num_word NUM>, <&sl NUM>;
              tapping-term-ms = <200>;)
*/

              
// Hold: momentairy mouse-layer | Tap: toggle mouse-layer (toggles off with a non mouse keypress)
#define SMART_MOUSE &smart_mouse MOUSE 0 //MOUSE
ZMK_HOLD_TAP(smart_mouse, 
    bindings = <&mo>, <&temp_mouse>; //<&tog>; 
    flavor = "balanced"; 
    tapping-term-ms = <200>;
    quick-tap-ms = <175>;)
ZMK_TRI_STATE(temp_mouse, 
    bindings = <&tog MOUSE>, <&none>, <&tog MOUSE>;
    ignored-key-positions =
        <LT2 LM3 LM2 LM1 LB2 LH2 LH1 RT1 RT2 RT3 RM1 RM2 RM3>; 
    ignored-layers = <MOUSE NAV FN>;)



// Define mod-morph with a *single* mod trigger for less repetition.
#define SIMPLE_MORPH(NAME, MOD, BINDING1, BINDING2)                            \
  ZMK_MOD_MORPH(NAME, mods = <(MOD_L##MOD | MOD_R##MOD)>;                      \
                bindings = <BINDING1>, <BINDING2>;)


// Tap: comma | Shift + tap: semicolon.
SIMPLE_MORPH(comma_morph, SFT, &kp COMMA, &kp SEMI)

// Tap: dot | Shift + tap: colon.
SIMPLE_MORPH(dot_morph, SFT, &kp DOT, &kp COLON)

// Tap: qmark | Shift + tap: excl.
SIMPLE_MORPH(excl_morph, SFT, &kp EXCL, &kp QMARK)

// Tap: left/right parenthesis | Shft + tap: less-than/greater-than.
SIMPLE_MORPH(lpar_lt, SFT, &kp LPAR, &kp LT)
SIMPLE_MORPH(rpar_gt, SFT, &kp RPAR, &kp GT)

// Tap: left/right curly-bracket | Shft + tap: left/right square-bracket.
SIMPLE_MORPH(lbrc_lbkt, SFT, &kp LBRC, &kp LBKT)
SIMPLE_MORPH(rbrc_rbkt, SFT, &kp RBRC, &kp RBKT)


// Sticky shift + leader. (for typing special characters in upper case)
ZMK_MACRO(leader_sft, bindings = <&sk LSHFT &leader>;) 


// Trigger tap-action on all interrupts.
#define MT_CORE                                                                \
  flavor = "tap-preferred";                                                    \
  tapping-term-ms = <220>;                                                     \
  quick-tap-ms = <220>;                                                        \
  hold-trigger-key-positions = <0>;

&mt { MT_CORE };

ZMK_HOLD_TAP(mt_home, bindings = <&masked_home>, <&kp>; MT_CORE)
ZMK_HOLD_TAP(mt_end, bindings = <&masked_end>, <&kp>; MT_CORE)

#define NAV_LEFT  &mt_home 0   LEFT  // Tap: left  | Long-tap: start of line.
#define NAV_RIGHT &mt_end 0    RIGHT // Tap: right | Long-tap: end   of line.
#define NAV_UP    &mt LC(HOME) UP    // Tap: up    | Long-tap: start of doc.
#define NAV_DOWN  &mt LC(END)  DOWN  // Tap: down  | Long-tap: end   of doc.
#define NAV_BSPC  &mt LC(BSPC) BSPC  // Tap: bspc  | Long-tap: delete word bwd.
#define NAV_DEL   &mt LC(DEL)  DEL   // Tap: del   | Long-tap: delete word fwd.

// Mask CTRL on left/right hold to avoid accidental jumps to start/end of doc.
#define MASK_MODS(NAME, MODS, BINDING)                                         \
  ZMK_MOD_MORPH(NAME, bindings = <BINDING>, <BINDING>; mods = <MODS>;)

MASK_MODS(masked_home, (MOD_LCTL), &kp HOME)
MASK_MODS(masked_end,  (MOD_LCTL), &kp END)


// Alt+Tab swapper.
ZMK_TRI_STATE(swapper, bindings = <&kt LALT>, <&kp TAB>, <&kt LALT>;
              ignored-key-positions = <LT2 RT2 RM1 RM2 RM3>;)


/ {
    keymap {
        compatible = "zmk,keymap"; 
        DEF {
            bindings = <
         &kp Q       &kp W       &kp F         &kp P              &kp B       &kp J    &kp L           &kp U         &kp Y       &kp SQT
         &hml LGUI A &hml LALT R &hml LCTRL S  &hmls LSHFT T      &kp G       &kp M    &hmrs RSHFT N   &hmr RCTRL E  &hmr RALT I  &hmr RGUI O
&trans   &kp Z       &kp X       &kp C         &kp D              &kp V       &kp K    &kp H           &comma_morph  &dot_morph  &excl_morph   &trans
                                 &lt FN DEL    &lt NAV BACKSPACE  &kp TAB     &kp RET  &lt NUM SPACE   SMART_MOUSE
            >;
        };

        NUM {
            bindings = <
        &kp ESC       &kp N7        &kp N8         &kp N9         &trans    &kp CAPS    &kp PG_UP  NAV_UP    &trans     &trans
        &hml LGUI N0  &hml LALT N4  &hml LCTRL N5  &hml LSHFT N6  &trans    &caps_word  NAV_LEFT   NAV_DOWN  NAV_RIGHT  &kp RET
&trans  &trans        &kp N1        &kp N2         &kp N3         &trans    &kp TAB     &kp PG_DN  &kp INS   &trans     &trans  &trans
                                    &trans         &trans         &trans    &trans      &trans     &trans
            >;
        };

        NAV { 
            bindings = <
        &kp LA(F4)  &trans    &kp LS(TAB)  &swapper   &trans    &kp CAPS    &kp PG_UP  NAV_UP    &trans     &trans
        &sk LGUI    &sk LALT  &sk LCTRL    &sk LSHFT  &trans    &caps_word  NAV_LEFT   NAV_DOWN  NAV_RIGHT  &kp RET
&trans  &trans      &trans    &trans       &kp N3     &trans    &kp TAB     &kp PG_DN  &kp INS   &trans     &trans  &trans
                              &trans       &trans     &trans    &trans      &trans     &trans
            >;
        };

        FN {
            bindings = <
        &trans  &kp C_BRI_DN  &trans        &kp C_BRI_UP  &bt BT_SEL 0    &trans  &trans     &trans     &trans    &bt BT_CLR
        &trans  &kp C_VOL_DN  &kp C_MUTE    &kp C_VOL_UP  &bt BT_SEL 1    &trans  &sk RSHFT  &sk RCTRL  &sk RALT  &sk RGUI
&trans  &trans  &kp C_PREV    &kp C_PP      &kp C_NEXT    &bt BT_SEL 2    &trans  &trans     &trans     &trans    &trans    &trans
                              &trans        &trans        &trans          &trans  &trans     &trans
            >;
        };

        MOUSE {
            bindings = <
       &trans  &trans  MSC_U   &trans   &trans    &trans  MSC_L   MMV_U   MSC_R   &trans
       &trans  MKP_R   MSC_D   MKP_L    &trans    &trans  MMV_L   MMV_D   MMV_R   &trans   
&none  &trans  &trans  MKP_M   &trans   &trans    &trans  &trans  &trans  &trans  &trans  &none
                       &mo FN  &mo NAV  &trans    &trans  &trans  &none 
            >;
        };

        GAME {
            bindings = <
        &trans  &trans  &kp W   &trans  &trans    &trans  &trans    &kp UP    &trans     &trans
        &trans  &kp A   &kp S   &kp D   &trans    &trans  &kp LEFT  &kp DOWN  &kp RIGHT  &trans
&trans  &trans  &trans  &trans  &trans  &trans    &trans  &trans    &trans    &trans     &trans  &trans
                        &trans  &trans  &trans    &trans  &trans    &trans
            >;
        };
    };
}; 